/*
 * ml_controller.ino  -  offline ML irrigation controller (Arduino Uno)
 *
 * 1. read the soil sensor (averaged exactly like sensor_logger.ino)
 * 2. read the DHT11
 * 3. apply the same preprocessing as training (soilRawToMoisturePct in model.h)
 * 4. run the exported model (needsWater in model.h)
 * 5. decide WATER / NO_WATER
 * 6. switch the relay, which switches the 12 V pump
 * 7. run the pump for a fixed, configurable time, then let the water soak in
 * 8. print every input and the decision to Serial
 *
 * model.h is GENERATED by `python -m src.export_embedded`. The copy shipped
 * in this folder is a placeholder that stops compilation until a model
 * trained on REAL data has been exported.
 *
 * Electrical safety: this sketch only drives the relay's IN pin. The pump is
 * powered from the 12 V supply through the relay's COM/NO contacts and is
 * never connected to an Arduino pin.
 *
 * Library: "DHT sensor library" by Adafruit (+ "Adafruit Unified Sensor").
 */

#include <DHT.h>
#include "model.h"

// Refuse to build with a model trained on synthetic demo data unless the
// developer explicitly asks for it (e.g. to bench-test the relay).
#if MODEL_IS_DEMO && !defined(ALLOW_DEMO_MODEL)
#error "model.h was trained on SYNTHETIC demo data. Export a model trained on real data, or #define ALLOW_DEMO_MODEL above the #include to bench-test only."
#endif

// ---- Pin configuration (defaults; confirm against your actual wiring) ----
#define DHT_PIN 4
#define DHT_TYPE DHT11
#define SOIL_PIN A0
#define RELAY_PIN 7
#define RELAY_ACTIVE_LOW true   // true if the relay switches ON when IN is LOW

// ---- Behaviour ----
#define SERIAL_BAUD 9600
#define SAMPLE_INTERVAL_MS 60000UL     // time between decisions
#define PUMP_RUN_MS 3000UL             // how long the pump runs per WATER decision
#define SOAK_TIME_MS 600000UL          // wait after watering before deciding again (water must reach the sensor)
#define MAX_WATERINGS_PER_DAY 6        // hard safety cap, independent of the model

// ---- Must match sensor_logger.ino (the training data was produced this way) ----
#define SOIL_SAMPLES 10
#define SOIL_SAMPLE_DELAY_MS 10

DHT dht(DHT_PIN, DHT_TYPE);

unsigned long dayStartMs = 0;
int wateringsToday = 0;

void relayWrite(bool on) {
  bool level = RELAY_ACTIVE_LOW ? !on : on;
  digitalWrite(RELAY_PIN, level ? HIGH : LOW);
}

int readSoilRaw() {
  long sum = 0;
  for (int i = 0; i < SOIL_SAMPLES; i++) {
    sum += analogRead(SOIL_PIN);
    delay(SOIL_SAMPLE_DELAY_MS);
  }
  return (int)(sum / SOIL_SAMPLES);
}

void runPump(unsigned long ms) {
  relayWrite(true);
  delay(ms);
  relayWrite(false);
}

void setup() {
  relayWrite(false);            // set the OFF level before enabling the output,
  pinMode(RELAY_PIN, OUTPUT);   // so the pump does not twitch at power-up
  relayWrite(false);

  Serial.begin(SERIAL_BAUD);
  dht.begin();
  delay(2000);

  Serial.print("# ml_controller started, model: ");
  Serial.println(MODEL_NAME);
#if MODEL_IS_DEMO
  Serial.println("# WARNING: DEMO model trained on synthetic data - bench test only");
#endif
  dayStartMs = millis();
}

void loop() {
  if (millis() - dayStartMs >= 86400000UL) {   // rolling 24 h window for the safety cap
    dayStartMs = millis();
    wateringsToday = 0;
  }

  int soilRaw = readSoilRaw();
  float humidity = dht.readHumidity();
  float temperature = dht.readTemperature();

  if (isnan(humidity) || isnan(temperature)) {
    // Fail safe: without all inputs the model cannot be applied, so do not water.
    Serial.println("# DHT11 read failed - no decision, pump stays OFF");
    delay(SAMPLE_INTERVAL_MS);
    return;
  }

#if MODEL_SOIL_FEATURE_IS_PCT
  float soilFeature = soilRawToMoisturePct((float)soilRaw);
#else
  float soilFeature = (float)soilRaw;
#endif
  bool water = needsWater(soilFeature, temperature, humidity);

  Serial.print("Soil raw: ");
  Serial.print(soilRaw);
#if MODEL_SOIL_FEATURE_IS_PCT
  Serial.print(" | Moisture: ");
  Serial.print(soilFeature, 1);
  Serial.print(" %");
#endif
  Serial.print(" | Temperature: ");
  Serial.print(temperature, 1);
  Serial.print(" C | Humidity: ");
  Serial.print(humidity, 1);
  Serial.print(" % | Decision: ");
  Serial.println(water ? "WATER" : "NO_WATER");

  if (water) {
    if (wateringsToday >= MAX_WATERINGS_PER_DAY) {
      Serial.println("# Daily watering cap reached - pump NOT started (check sensor/model)");
    } else {
      Serial.print("# Pump ON for ");
      Serial.print(PUMP_RUN_MS);
      Serial.println(" ms");
      runPump(PUMP_RUN_MS);
      wateringsToday++;
      Serial.println("# Pump OFF, soaking");
      delay(SOAK_TIME_MS);
      return;
    }
  }
  delay(SAMPLE_INTERVAL_MS);
}
